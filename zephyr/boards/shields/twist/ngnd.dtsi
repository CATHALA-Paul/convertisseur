/*
 * Copyright (c) 2022 OwnTech.
 *
 * SPDX-License-Identifier: LGLPV2.1
 */

 / {
	ngnd: ngnd-switch {
		compatible = "gpio-device";
		ngnd-gpio-pin {
			gpios = <&spin_header 1 GPIO_ACTIVE_HIGH>;
			label = "Neutral to GND shunt";
		};
	};
};
