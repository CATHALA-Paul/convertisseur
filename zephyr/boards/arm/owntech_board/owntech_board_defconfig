## zephyr/boards/arm/owntech_board/owntech_board_defconfig
```kconfig
# SPDX-License-Identifier: Apache-2.0

CONFIG_SOC_SERIES_STM32G4X=y
CONFIG_SOC_STM32G474XX=y

# enable uart driver
CONFIG_SERIAL=y

# enable pinmux
CONFIG_PINMUX=y

# enable GPIO
CONFIG_GPIO=y

# Enable Clocks
CONFIG_CLOCK_CONTROL=y

# Console
CONFIG_CONSOLE=y
CONFIG_UART_CONSOLE=y

# Enable MPU
CONFIG_ARM_MPU=y

# Enable HW stack protection
CONFIG_HW_STACK_PROTECTION=y

# CAN default configuration
CONFIG_ISOTP_RX_BUF_COUNT=2
#A frame has 7 bytes payload, we are using a BS of 8 and need one char for the
#string termination (7 * 8 + 1 = 57)
CONFIG_ISOTP_RX_BUF_SIZE=57
#We have two receiving contexts that are bound to a single address.
CONFIG_ISOTP_RX_SF_FF_BUF_COUNT=2
```

## zephyr/modules/owntech_communication/zephyr/Kconfig
```kconfig
config OWNTECH_COMMUNICATION
	bool "Enable OwnTech communication module"
	default y

if OWNTECH_COMMUNICATION

	config OWNTECH_COMMUNICATION_ENABLE_ANALOG
		bool "Enable analogic communication API"
		default y
		select OWNTECH_DATA_ACQUISITION
		select OWNTECH_HARDWARE_CONFIGURATION

	config OWNTECH_COMMUNICATION_ENABLE_CAN
		bool "Enable CAN bus communication API (Thingset over CAN)"
		default n
		select CAN
		select ISOTP
		select THINGSET
		select OWNTECH_DATA_ACQUISITION

	config OWNTECH_COMMUNICATION_ENABLE_RS485
		bool "Enable RS485 bus communication API"
		default n

	config OWNTECH_COMMUNICATION_ENABLE_SYNC
		bool "Enable synchronization API"
		default y

endif
```

## zephyr/modules/owntech_scheduling/zephyr/Kconfig
```kconfig
config OWNTECH_SCHEDULING
	bool "Enable OwnTech scheduling"
	default y
	depends on OWNTECH_TIMER_DRIVER
	depends on OWNTECH_HRTIM_DRIVER
	depends on OWNTECH_DATA_ACQUISITION

if OWNTECH_SCHEDULING

	config OWNTECH_SCHEDULING_ENABLE_ASYNCHRONOUS_TASKS
		bool "Enable support for asychronous tasks"
		help
			Asynchronous tasks are run in background when no synchronous task is running.
		default y

	config OWNTECH_SCHEDULING_MAX_ASYNCHRONOUS_TASKS
		int "Maximum number of asychronous tasks"
		help
			The higher this value, the more RAM will be reserved for tasks and unavailable to the main program.
		default 3
		range 1 5

	config OWNTECH_SCHEDULING_ASYNCHRONOUS_TASKS_STACK_SIZE
		int "Stack size for asynchronous threads"
		default 512

	config OWNTECH_SCHEDULING_TIMING
		bool "Records timings of data acquisitions and control task"
		help
			Enabling scheduling timing creates 4 arrays containing 2048 values. These array store the timings
			Before data_dispatch, after data_dispatch, before the control task, and after the control task. 
			As such these values can be retrieved through the debugger to get a real life insights on the time taken 
			to retrieve data, and to the computation time of the control task.
		select TIMING_FUNCTIONS
		default n
		

endif
```

## zephyr/modules/owntech_task_api/zephyr/Kconfig
```kconfig
config OWNTECH_TASK_API
	bool "Enable OwnTech scheduling"
	default y
	depends on OWNTECH_TIMER_DRIVER
	depends on OWNTECH_HRTIM_DRIVER
	depends on OWNTECH_DATA_API

if OWNTECH_TASK_API

	config OWNTECH_TASK_ENABLE_ASYNCHRONOUS_TASKS
		bool "Enable support for asychronous tasks"
		help
			Asynchronous tasks are run in background when no synchronous task is running.
		default y

	config OWNTECH_TASK_MAX_ASYNCHRONOUS_TASKS
		int "Maximum number of asychronous tasks"
		help
			The higher this value, the more RAM will be reserved for tasks and unavailable to the main program.
		default 3
		range 1 5

	config OWNTECH_TASK_ASYNCHRONOUS_TASKS_STACK_SIZE
		int "Stack size for asynchronous threads"
		default 1024

	config OWNTECH_SCHEDULING_TIMING
		bool "Records timings of data acquisitions and control task"
		help
			Enabling scheduling timing creates 4 arrays containing 2048 values. These array store the timings
			Before data_dispatch, after data_dispatch, before the control task, and after the control task. 
			As such these values can be retrieved through the debugger to get a real life insights on the time taken 
			to retrieve data, and to the computation time of the control task.
		select TIMING_FUNCTIONS
		default n
		

endif
```
