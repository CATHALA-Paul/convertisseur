#include <unity.h>
#include <HardwareConfiguration.h>
#include <DataAcquisition.h>
#include <Scheduling.h>
// #include "CanCommunication.h"
#include <opalib_control_pid.h>

//------------ZEPHYR DRIVERS----------------------
#include <zephyr.h>
#include <console/console.h>
#include <drivers/gpio.h>
#include <timing/timing.h>


#define APPLICATION_THREAD_PRIORITY 3
#define COMMUNICATION_THREAD_PRIORITY 5

//--------------SETUP FUNCTIONS DECLARATION-------------------
void setup_hardware(); //setups the hardware peripherals of the system
void setup_software(); //setups the scheduling of the software and the control method

//-------------LOOP FUNCTIONS DECLARATION----------------------
//-------------LOOP FUNCTIONS DECLARATION----------------------
void loop_communication_task(); //code to be executed in the slow communication task
int8_t CommTask_num;            // Communication Task number
void loop_application_task();   //code to be executed in the fast application task
int8_t AppTask_num;             // Application Task number       
void loop_control_task();       //code to be executed in real-time at 20kHz


enum serial_interface_menu_mode //LIST OF POSSIBLE MODES FOR THE OWNTECH CONVERTER
{
    IDLEMODE = 0,
    SERIALMODE,
    POWERMODE,
    BOOSTMODE,
    BUCKMODE,
    INVERTERMODE,
};

uint8_t received_serial_char;
uint8_t mode = IDLEMODE;

//--------------USER VARIABLES DECLARATIONS----------------------
static float32_t voltage_reference = 20; //voltage reference (app task)
static float32_t current_reference = 1.0; //voltage reference (app task)
static int cpt_step = 0; //counter for voltage reference (app task)

static float32_t kp = 0.000215;
static float32_t ki = 2.86;
static float32_t kd = 0.0;

static float32_t duty_cycle = 0.04; //[-] duty cycle (comm task)
static float32_t duty_cycle_power_init = 0.04; //[-] duty cycle (comm task)
static float32_t duty_cycle_inv_init = 0.5; //[-] duty cycle (comm task)
static float32_t duty_cycle_step = 0.02; //[-] duty cycle step (comm task)
static float32_t duty_cycle_power_max = 0.4; //[-] duty cycle max (control task)
static float32_t duty_cycle_power_min = 0.04; //[-] duty cycle max (control task)
static float32_t duty_cycle_inv_max = 0.7; //[-] duty cycle max (control task)
static float32_t duty_cycle_inv_min = 0.03; //[-] duty cycle max (control task)
static float32_t duty_cycle_new = 0.5; //new duty cycle that has been calculated
static float32_t Vhigh_max = 100; //store value of Vhigh (app task)
static float32_t Vbatt_max = 83; //store the maximum battery voltage

static bool pwm_enable = false; //[bool] state of the PWM (ctrl task)
static bool charge_enable = false; //[bool] state of the PWM (ctrl task)
static uint32_t control_task_period = 50; //[us] period of the control task

static float32_t V1_low_value; //store value of V1_low (app task)
static float32_t V2_low_value; //store value of V2_low (app task)
static float32_t Vhigh_value; //store value of Vhigh (app task)

static float32_t i1_low_value; //store value of i1_low (app task)
static float32_t i2_low_value; //store value of i2_low (app task)
static float32_t ihigh_value; //store value of ihigh (app task)

static float32_t extra_value; //store value of extra data (app task)

static float32_t meas_data; //temp storage meas value (ctrl task)

static uint16_t can_device_address;    //address of the can device

static float32_t sin_angle[] = {0,0.00628314396555895,0.0125660398833526,0.0188484397154082,0.0251300954433375,0.0314107590781283,0.0376901826699345,0.0439681183178649,0.0502443181797696,0.0565185344820245,0.0627905195293134,0.0690600257144058,0.0753268055279327,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-0.012566039883353,-0.00628314396555881};
static uint16_t period = 1000; // nb of points in the lookup table for 360 degrees
static uint16_t phase_shift = 0; // index in the lookup table corresponding to the pahse shift (500/1000 = 180 deg)

static uint8_t dac_comm_number = 2;
static uint8_t dac_comm_channel = 1;
static uint32_t dac_comm_value = 0;
static uint32_t dac_comm_counter = 0;
timing_t start_time, end_time;
uint64_t total_cycles[100];
uint64_t total_ns[100];
bool data_rdy = 0;
int cnt=0;

uint64_t sum = 0;
uint64_t mean = 0;
uint64_t var = 0;
uint64_t stdev = 0;
  

//---------------------------------------------------------------


//---------------SETUP FUNCTIONS----------------------------------

void setup_hardware()
{
    hwConfig.setBoardVersion(TWIST_v_1_1_2);
    hwConfig.configureAdcDefaultAllMeasurements();
    hwConfig.configureAdcDefaultAllMeasurementsAndExtra();
    hwConfig.initInterleavedBuckModeCenterAligned();
    hwConfig.initDacConstValue(dac_comm_number);
    hwConfig.setNgndOn();
    console_init();
}

void setup_software()
{
    opalib_control_init_interleaved_pid(kp, ki, kd, control_task_period);

    dataAcquisition.start();

    dataAcquisition.setVHighParameters(0.067,0.449);
    dataAcquisition.setV1LowParameters(0.0448,91.36);
    dataAcquisition.setV2LowParameters(0.0449,91.38);

    dataAcquisition.setIHighParameters(0.005,-10.3);
    dataAcquisition.setI1LowParameters(0.005,-10.4);
    dataAcquisition.setI2LowParameters(0.005,-10.3);
    
    AppTask_num =  scheduling.defineAsynchronousTask(loop_application_task);
    CommTask_num = scheduling.defineAsynchronousTask(loop_communication_task);
    scheduling.defineUninterruptibleSynchronousTask(&loop_control_task, control_task_period);

    scheduling.startAsynchronousTask(AppTask_num);
    scheduling.startAsynchronousTask(CommTask_num);
    scheduling.startUninterruptibleSynchronousTask();
    timing_init();
    timing_start();

}

//---------------LOOP FUNCTIONS----------------------------------

void loop_communication_task()
{
  while(1) {
    received_serial_char = console_getchar();
    switch (received_serial_char) {
      case 'h':
          //----------SERIAL INTERFACE MENU-----------------------
      printk(" ________________________________________\n");
            printk("|     ------- MENU ---------             |\n");
            printk("|     press i : idle mode                |\n");
            printk("|     press s : serial mode              |\n");
            printk("|     press p : power mode               |\n");
            printk("|     press u : duty cycle UP            |\n");
            printk("|     press d : duty cycle DOWN          |\n");
            printk("|     press b : closed-loop buck mode    |\n");
            printk("|________________________________________|\n\n");
            //------------------------------------------------------
        break;
      case 'i':
          // printk("idle mode\n");
          mode = IDLEMODE;
          break;
      case 's':
          // printk("serial mode\n");
          mode = SERIALMODE;
          break;
      case 'p':
          // printk("power mode\n");
          mode = POWERMODE;
          hwConfig.setNgndOn();
          duty_cycle = duty_cycle_power_init;
          break;
      case 'u':
          // printk("duty cycle UP: %f\n", duty_cycle);
          if(mode == POWERMODE){
              duty_cycle = duty_cycle + duty_cycle_step;
              if (duty_cycle>duty_cycle_power_max) duty_cycle = duty_cycle_power_max;
          }
          if (mode == INVERTERMODE){
              duty_cycle = duty_cycle + duty_cycle_step;
              if (duty_cycle>duty_cycle_inv_max) duty_cycle = duty_cycle_inv_max;
          }
          break;
      case 'd':
          // printk("duty cycle DOWN: %f\n", duty_cycle);
          if(mode == POWERMODE){
              duty_cycle = duty_cycle - duty_cycle_step;
              if (duty_cycle<duty_cycle_power_min) duty_cycle = duty_cycle_power_min;
          }
          if (mode == INVERTERMODE){
              duty_cycle = duty_cycle - duty_cycle_step;
              if (duty_cycle<duty_cycle_inv_min) duty_cycle = duty_cycle_inv_min;
          }
          break;
      case 'b':
          mode = BOOSTMODE;
          break;
      case 'k':
          mode = BUCKMODE;
          break;
      case 'v':
          mode = INVERTERMODE;
          hwConfig.setNgndOff();
          duty_cycle = duty_cycle_inv_init;
          break;
      default:
          break;
    }
  }
}


void loop_application_task()
{

  while(1){
    if(mode==IDLEMODE) {
      hwConfig.setLedOff();
    }
    else if(mode==SERIALMODE) {
      hwConfig.setLedOn();
      if(dac_comm_counter==30) {
        dac_comm_counter=10;
      }
      dac_comm_value = 100*dac_comm_counter;
      dac_comm_counter++;
      }
    else if(mode==POWERMODE) {
      hwConfig.setLedOn();
    }
    else if(mode==BOOSTMODE || mode == BUCKMODE || mode==INVERTERMODE) {
      if(cpt_step==10)
        hwConfig.setLedOn();
      if(cpt_step==20) {
        hwConfig.setLedOff();
        cpt_step=0;
      }
        cpt_step++;
    }
    printk("%f:", (float32_t)(dac_comm_value));
    printk("%f:", Vhigh_value);
    printk("%f:", V1_low_value);
    printk("%f:", V2_low_value);
    printk("%f:", ihigh_value);
    printk("%f:", i1_low_value);
    printk("%f:", extra_value);
    printk("%f\n", i2_low_value);

    k_msleep(100);    
  }        
}

void loop_control_task()
{
  start_time = timing_counter_get();
  meas_data = dataAcquisition.getVHigh();
  if(meas_data!=-10000) Vhigh_value = meas_data;

  meas_data = dataAcquisition.getV1Low();
  if(meas_data!=-10000) V1_low_value = meas_data;

  meas_data = dataAcquisition.getV2Low();
  if(meas_data!=-10000) V2_low_value= meas_data;

  meas_data = dataAcquisition.getIHigh();
  if(meas_data!=-10000) ihigh_value = meas_data;

  meas_data = dataAcquisition.getI1Low();
  if(meas_data!=-10000) i1_low_value = meas_data;

  meas_data = dataAcquisition.getI2Low();
  if(meas_data!=-10000) i2_low_value = meas_data;

  meas_data = dataAcquisition.getExtra();
  if(meas_data!=-10000) extra_value = meas_data;


  if(mode==IDLEMODE || mode==SERIALMODE) {
    if(pwm_enable) {
      pwm_enable = false;
      hwConfig.setInterleavedOff();
    }
    // dac_comm_value = i1_low_value;
    hwConfig.setDacConstValue(dac_comm_number,dac_comm_channel,dac_comm_value);
  }

  else if(mode==POWERMODE || mode==BOOSTMODE || mode == BUCKMODE || mode == INVERTERMODE) {
    if(!pwm_enable) {
      pwm_enable = true;
      hwConfig.setInterleavedOn();
    }
    if(mode==POWERMODE){
      hwConfig.setInterleavedDutyCycle(duty_cycle);
    } 
    if(mode==BOOSTMODE){      
      if(Vhigh_value>=Vbatt_max){ 
        hwConfig.setInterleavedOff();
        charge_enable = false;
      }
      else {
        if(!charge_enable) { 
            hwConfig.setInterleavedOn();
            charge_enable = true;
        }
        duty_cycle = opalib_control_interleaved_pid_calculation(current_reference, -1*ihigh_value);
        hwConfig.setInterleavedDutyCycle(duty_cycle);
      }
    }         
    if(mode==BUCKMODE){
        duty_cycle = opalib_control_interleaved_pid_calculation(voltage_reference, V1_low_value);
        hwConfig.setInterleavedDutyCycle(duty_cycle);
    }            
    if(mode==INVERTERMODE){
      if (cpt_step<period && cpt_step>=0){
        duty_cycle=0.3*sin_angle[(cpt_step+phase_shift)%period]+0.5;
        if (duty_cycle>=0.5) {
          hwConfig.setLedOn();
        }
        else {
          hwConfig.setLedOff();
        }
        cpt_step ++;
      } 
      else if(cpt_step>=period){
        cpt_step=0;
      }
      hwConfig.setFullBridgeBuckDutyCycle(duty_cycle);
      end_time = timing_counter_get();
      if(cnt<100){
        total_cycles[cnt] = timing_cycles_get(&start_time, &end_time);
        cnt++;
      }
      else {
        data_rdy = 1;
      }
    }   
  }
}

void test_timing(void){

  if(data_rdy==1){
    for(int i=0; i < 100; i++){
      total_ns[i] = timing_cycles_to_ns(total_cycles[i]);
    }
    for (int j = 0; j < 100; j++) {
      sum += total_ns[j];
    }
  mean = sum/100;
    for (int k = 0; k < 100; k++) {
      var += (mean - total_ns[k]) * (mean - total_ns[k]);
    }
  stdev = sqrt(var/100);
  }

  printk("Control loop execution time : Mean = %d ns, Standard deviation = %d ns\n", mean, stdev);
}

void setUp(void) {
    setup_hardware();
    setup_software();
}

void tearDown(void) {
  // clean stuff up here
}


int main(void) {
    UNITY_BEGIN();
    RUN_TEST(test_timing);
    return UNITY_END();
}