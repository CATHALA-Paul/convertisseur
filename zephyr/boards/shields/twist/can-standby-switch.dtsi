/*
 * Copyright (c) 2022 OwnTech.
 *
 * SPDX-License-Identifier: LGLPV2.1
 */

/ {
	can-standby-switch {
		compatible = "gpio-device";
		can-standby-gpio-pin {
			gpios = <&spin_header 41 GPIO_ACTIVE_HIGH>;
			label = "CAN Standby output";
		};
	};
};
